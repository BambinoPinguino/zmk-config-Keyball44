## config/dts/bindings/behaviors/zmk,behavior-bongo-screen.yaml
```yaml
# Copyright (c) 2026 The Bongocat ZMK Contributors
# SPDX-License-Identifier: MIT

description: Switch the display between bongo cat and the stock status screen

compatible: "zmk,behavior-bongo-screen"

include: behavior-metadata.yaml

properties:
  label:
    type: string
    required: false
    deprecated: true
  "#binding-cells":
    type: int
    required: true
    const: 1

binding-cells:
  - param1
```
